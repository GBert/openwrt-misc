## c2port-gpio/src/Kconfig
```kconfig
config C2PORT_GPIO
    tristate "C2PORT GPIO"
    depends on GENERIC_GPIO
    select C2PORT_GPIO
    help
      C2PORT GPIO driver
```

## c2t-module/src/Kconfig
```kconfig
config C2TOOL_GPIO
    tristate "C2PORT GPIO"
    depends on GENERIC_GPIO
    select C2TOOL_GPIO
    help
      C2TOOL GPIO driver
```

## carambola_i2c_test/src/Kconfig
```kconfig
config I2C_RALINK_TEST
    tristate "I2C RALINK TEST"
    depends on I2C_CORE
    select I2C_RALINK_TEST
    help
      Ralink I2C test
```
